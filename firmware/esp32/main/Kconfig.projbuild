## firmware/esp32/main/Kconfig.projbuild
```kconfig
menu "Robot configuration"

config ROBOT_AGENT_IP
    string "micro-ROS Agent IPv4 address"
    default "10.243.102.224"

config ROBOT_AGENT_PORT
    int "micro-ROS Agent UDP port"
    range 1 65535
    default 8888

endmenu
```

## prototypes/esp32-http-control/remoteCart/main/Kconfig.projbuild
```kconfig
menu "RemoteCart configuration"

config REMOTECART_WIFI_SSID
    string "Access point name"
    default "ESP-RemoteCart"

config REMOTECART_WIFI_PASSWORD
    string "Access point password"
    default "12345678"

config REMOTECART_WIFI_CHANNEL
    int "Wi-Fi channel"
    range 1 13
    default 6

config REMOTECART_MAX_CONNECTIONS
    int "Maximum connected devices"
    range 1 10
    default 4

config REMOTECART_COMMAND_TIMEOUT_MS
    int "Motor command timeout in milliseconds"
    range 100 5000
    default 500

endmenu
```
